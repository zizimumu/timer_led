#include "stm32f10x.h"
#include "delay.h"

#define SPI2CS_CLOCK  RCC_APB2Periph_GPIOB 
#define SPI2CS_PIN  GPIO_Pin_5
#define LCD_MODE_PIN GPIO_Pin_14
#define LCD_RS_PIN GPIO_Pin_6


#define SPI2CS_GPIO GPIOB

#define SPI2_CS_HIGH()  GPIO_SetBits(SPI2CS_GPIO,SPI2CS_PIN)
#define SPI2_CS_LOW() GPIO_ResetBits(SPI2CS_GPIO,SPI2CS_PIN)

#define LCD_RS_HIGH()  GPIO_SetBits(SPI2CS_GPIO,LCD_RS_PIN)
#define LCD_RS_LOW() GPIO_ResetBits(SPI2CS_GPIO,LCD_RS_PIN)


#define LCD_DO_WRITE()  GPIO_SetBits(SPI2CS_GPIO,LCD_MODE_PIN)
#define LCD_DO_CONTROL() GPIO_ResetBits(SPI2CS_GPIO,LCD_MODE_PIN)



const uint8_t  ascii_table_5x7[95][5]={
0x00,0x00,0x00,0x00,0x00,//space
0x00,0x00,0x4f,0x00,0x00,//!
0x00,0x07,0x00,0x07,0x00,//"
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0x04,0x02,0x02,0x02,0x01,//~
};

void SPI2_CS_Config(void)
{
	GPIO_InitTypeDef GPIO_InitStructure;

	RCC_APB2PeriphClockCmd(SPI2CS_CLOCK, ENABLE);
	
	GPIO_InitStructure.GPIO_Pin = SPI2CS_PIN|LCD_MODE_PIN|LCD_RS_PIN;
	GPIO_InitStructure.GPIO_Mode = GPIO_Mode_Out_PP;		
	GPIO_InitStructure.GPIO_Speed = GPIO_Speed_50MHz;
	GPIO_Init(SPI2CS_GPIO, &GPIO_InitStructure);	
}

void LCD_WriteControl(unsigned char cmd)
{
	LCD_DO_CONTROL();
	//delay_us(10);
	SPI2_UserWriteByte(cmd);
	delay_us(10);

}
void LCD_WriteData(unsigned char data)
{
	LCD_DO_WRITE();
	//delay_us(10);
	SPI2_UserWriteByte(data);
	delay_us(10);

}


void set_ddram_line_col(unsigned char line,unsigned char col)
{

  unsigned char page,coll,coll_l,coll_h;
  page = line;
  coll = col;
  coll_h = coll>>4;
  coll_l = coll&0x0f;
  LCD_WriteControl(0xB0+page);
  delay_us(15); // 15 us
  LCD_WriteControl(0x10+coll_h);
  delay_us(15); // 15 us
  LCD_WriteControl(0x00+coll_l);
  delay_us(15); // 15 us
}
void HalLcd_HW_Clear(void)
{

  int i,j;
  for(i=0;i<8;i++){
        set_ddram_line_col(i,0);
	for(j=0;j<128;j++){
		LCD_WriteData(0x00);
	}
  }
}

void DisplayByte_5x7(unsigned char page,unsigned char column,unsigned char text)
{
	int j,k;

	if((text>=0x20)&&(text<0x7e)){/*需要显示的文字*/
		j=text-0x20;/*寻址，通过字符的ascii码找到点阵库中的改字符的位置*/
		set_ddram_line_col(page,column);
		for(k=0;k<5;k++)
		{
			LCD_WriteData(ascii_table_5x7[j][k]);/*显示5x7的ASCII字到LCD上，y为页地址，x为列地址，最后为数据*/
		}
		//第六列写入0，即清除上一次留下来的数据
		LCD_WriteData(0x00);
		column+=6;
	}else if(text==0x00){/*不需要显示，清空指定位置*/
		set_ddram_line_col(page,column);
		for(k=0;k<5;k++){
			LCD_WriteData(0x00); //清空指定的字符位置
		}
	}

}

void LCD_WriteString(char * str,unsigned char line,unsigned char column)
{
	unsigned char  i = 0;
	while(str[i] != 0){
		DisplayByte_5x7(line,column,str[i]);
		column += 7;
		i++;
	}
}

/***********************************
uint32_t sendData  : limit is 32bit
unsigned char rate : 0 -decimal  1-hex
unsigned char style: 0 - end with \r\n  1- end with ' '
429 496 729 5

**************************************/
void LCD_WriteInt(int32_t sendValue,unsigned char rate,unsigned char line,unsigned char column)
{
	unsigned char hexTmp[11];
	unsigned char decTmp[13];
	unsigned char i,value;
	uint32_t tmpValue,sendData;

	sendData = sendValue;
	if(sendValue < 0){
		DebugPrint("-");
		sendData = 0xffffffff - (uint32_t)sendValue +1;
	}
	if( 1 == rate){
		for(i=0;i<8;i++){
			value =(unsigned char)(( 0xf0000000&( sendData<<(i*4) ) )>>28 );
			if((0 <= value )&&(value <= 9))
				hexTmp[i] = value + 0x30;
			else if((10 <= value)&&(value <= 15))
				hexTmp[i] = value + 55;
		}

		hexTmp[8] = 0;

		i = 0;
		while(hexTmp[i] == '0'){
			i++;
			if(i == 8){
				LCD_WriteString((char *)&hexTmp[7],line,column);
				return ;
			}
		}
		LCD_WriteString((char *)&hexTmp[i],line,column);
	}
	else {
		tmpValue = sendData;
		for(i=0;i<10;i++){
			decTmp[9-i] = tmpValue%10 + 0x30;
			tmpValue = tmpValue/10;
		}

		decTmp[10] = 0;
		i = 0;
		while(decTmp[i] == '0'){
			i++;
			if(i == 10){
				LCD_WriteString((char *)&decTmp[9],line,column);
				return ;
			}

		}
		LCD_WriteString((char *)&decTmp[i],line,column);

	}

}

void LCD_Init(void)
{

	SPI2_UserInit();
	SPI2_CS_Config();

	LCD_RS_LOW();
	delay_us(10);
	LCD_RS_HIGH();
	
	SPI2_CS_LOW();

	LCD_WriteControl(0xe2);	//软复位
	delay_us(15); // 15 us
	LCD_WriteControl(0x2c);	//升压步聚1
	delay_us(15); // 15 us
	LCD_WriteControl(0x2e);	//升压步聚2
	delay_us(15); // 15 us
	LCD_WriteControl(0x2f);	//升压步聚3
	delay_us(150); // 15 us
	LCD_WriteControl(0x23);	//粗调对比度，可设置范围0x20～0x27
	delay_us(15); // 15 us
	LCD_WriteControl(0x81);	//微调对比度
	delay_us(15); // 15 us
	LCD_WriteControl(0x28);	//0x1a,微调对比度的值，可设置范围0x00～0x3f
	delay_us(15); // 15 us

	LCD_WriteControl(0xa2);	// 1/9偏压比（bias）
	delay_us(15); // 15 us
	LCD_WriteControl(0xa0);	//行扫描顺序：从上到下
	delay_us(15); // 15 us
	LCD_WriteControl(0xc8);	//列扫描顺序：从左到右
	delay_us(15); // 15 us
	LCD_WriteControl(0x40);	//起始行：第一行开始
	delay_us(15); // 15 us
	LCD_WriteControl(0xaf);	//打开显示
	delay_us(15); // 15 us
	LCD_WriteControl(0xa4);	
	delay_us(15); // 15 us

	HalLcd_HW_Clear();

	//DisplayByte_5x7(0,6,0x32);
	//DisplayByte_5x7(2,6,0x33);
	//DisplayByte_5x7(3,6,0x34);

	LCD_WriteString("step count is",0,0);

	//LCD_WriteInt(12456,0,6,0);
	//display_string_5x7(1,1,"abcdefghijklmnopqrstuvwxyz");
	//display_string_5x7(8,1,"uvwxyz0123456789");
	//while(1);


}

